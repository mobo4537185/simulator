## src/kernel/linux-3.10/drivers/_mobo/Kconfig
```kconfig
menuconfig MOBO
	bool "Driver By MoBo"
	help
	  Driver By MoBo
if MOBO

config S5PV210_TS
	tristate "TouchScreen of S5PV210"
	help
	  TouchScreen of S5PV210

endif
```
